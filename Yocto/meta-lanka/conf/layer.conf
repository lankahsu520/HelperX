## Yocto/meta-lanka/conf/layer.conf
```bitbake
# We have a conf and classes directory, add to BBPATH
BBPATH .= ":${LAYERDIR}"

# We have recipes-* directories, add to BBFILES
BBFILES += "${LAYERDIR}/recipes-*/*/*.bb \
            ${LAYERDIR}/recipes-*/*/*.bbappend"

BBFILE_COLLECTIONS += "meta-lanka"
BBFILE_PATTERN_meta-lanka = "^${LAYERDIR}/"
BBFILE_PRIORITY_meta-lanka = "6"

LAYERDEPENDS_meta-lanka = "core"
LAYERSERIES_COMPAT_meta-lanka = "langdale"
```
